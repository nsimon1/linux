// Definitions for NXP PCA9685A I2C PWM controller on ARM I2C bus.
/dts-v1/;
/plugin/;

/{
	compatible = "brcm,bcm2708";

	fragment@0 {
		target = <&i2c_arm>;
		__overlay__ {
			#address-cells = <1>;
			#size-cells = <0>;
			status = "okay";

			pca: pca@40 {
				compatible = "nxp,pca9685-pwm";
				#pwm-cells = <2>;
				reg = <0x40>;
				status = "okay";
				invert;
				open-drain;
			};
		};
	};
	__overrides__ {
		addr = <&i2cmux>,"reg:0";
	};
};
