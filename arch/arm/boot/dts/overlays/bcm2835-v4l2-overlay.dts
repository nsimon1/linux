/*
 * Device tree overlay for V4L2 camera overlay
 *
 * Compile:
 * dtc -@ -I dts -O dtb -o i2c0-bcm2708-overlay.dtb i2c0-bcm2708-overlay.dts
 */

/dts-v1/;
/plugin/;

/{
	compatible = "brcm,bcm2708";

	fragment@0 {
		target = <&soc>;
		__overlay__ {
			v4l2: v4l2 {
				compatible = "raspberrypi,bcm2835-v4l2";
				status = "okay";
			};
		};
	};

};
